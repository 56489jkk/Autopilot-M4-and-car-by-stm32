/*
 * Copyright (c) 2006-2021, RT-Thread Development Team
 *
 * SPDX-License-Identifier: Apache-2.0
 *
 * Change Logs:
 * Date           Author       Notes
 * 2022-04-06     CGY       the first version
 */
#include "DL_OpticalFlow_LC306.h"

opt_data LC306_opt_receive(uint8_t data)
{
    static opt_data T1_opt={0};
    static int16_t raw_data[2],dest_data[2];
    static uint8_t data_len = 0;
    static uint8_t state = 0;

    if(state==0&&data==0xFE)    //
    {
        state=1;
    }
    else if(state==1&&data==0x0A)   //
    {
        state=2;
        data_len = 12;
        T1_opt.dataLen = 0;
    }
    else if(state==2&&data_len>0)
    {
        data_len--;
        T1_opt.data[T1_opt.dataLen++]=data;
        if(data_len==0 && T1_opt.data[11]==0x55){
            state=0;
            T1_opt.sonar_timestamp = T1_opt.data[5]<<8|T1_opt.data[4];    //  20800us
            T1_opt.distance =  (T1_opt.data[7]<<8|T1_opt.data[6])/10;     //cm
            T1_opt.qual = T1_opt.data[8];
            if (T1_opt.qual==0xF5) {
                raw_data[0] =  ((int16_t)(T1_opt.data[1]<<8)|T1_opt.data[0]);   //向前
                raw_data[1] =  ((int16_t)(T1_opt.data[3]<<8)|T1_opt.data[2]);   //向右
                //调整传感器坐标系 使传感器坐标和飞控坐标对齐
                applySensorAlignment_2(dest_data,raw_data,Flow_Sensor_Rotation);
                T1_opt.raw_x = dest_data[0];   //向前
                T1_opt.raw_y = dest_data[1];   //向右
                T1_opt.last_update_ms = rt_tick_get();
            } else {
                T1_opt.raw_x = 0;   //
                T1_opt.raw_y = 0;
            }
        }
    }
    else
    {
        state=0;
    }

    return T1_opt;
}



/**********************************************LC306光流配置***************************************************/
#if 1
uint8_t SENSOR_IIC_ADDR=0xdc;
uint8_t tab_focus[4] = {0x96,0x26,0xbc,0x50};
uint8_t Sensor_cfg[]={
  0x12, 0x80,
  0x11, 0x30,
  0x1b, 0x06,
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  0x98, 0x1a
};
uint16_t LC306_Ready_Cnt=0;


int send_config_data_init = 0;
rt_device_t dev_lc306;
void send_config_data(uint8_t dataToSend)
{
    if (send_config_data_init==0) {
        send_config_data_init = 1;
        dev_lc306 = serial_device_find(SerialProtocol_Opt2);
        if(dev_lc306) set_serial_device_baud_rate(dev_lc306,19200);
    }

    if(dev_lc306)rt_device_write(dev_lc306, 0,&dataToSend,1);
}


int lc306_config_init(void)
{
    uint16_t len = sizeof(Sensor_cfg);
    send_config_data(0xAA);//0xAAָ
    send_config_data(0xAB);//0xAB
    send_config_data(tab_focus[0]);
    send_config_data(tab_focus[1]);
    send_config_data(tab_focus[2]);
    send_config_data(tab_focus[3]);
    send_config_data(tab_focus[0]^tab_focus[1]^tab_focus[2]^tab_focus[3]);

    rt_thread_mdelay(10);
    for(uint16_t i=0;i<len;i+=2)//0xBB
    {
        send_config_data(0xBB);
        send_config_data(SENSOR_IIC_ADDR);
        send_config_data(Sensor_cfg[i]);
        send_config_data(Sensor_cfg[i+1]);
        send_config_data(SENSOR_IIC_ADDR^Sensor_cfg[i]^Sensor_cfg[i+1]);
        rt_thread_mdelay(2);
    }

    send_config_data(0xDD);//0xDD

    return RT_EOK;
}
/* 导出到自动初始化 */
//INIT_APP_EXPORT(lc306_config_init);
#endif

